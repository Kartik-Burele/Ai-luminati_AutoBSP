## datasets/large/customer/defconfig
```kconfig
/* CUSTOMER defconfig */
CONFIG_FEATURE_1=n
CONFIG_FEATURE_2=n
CONFIG_FEATURE_3=n
CONFIG_FEATURE_4=n
CONFIG_FEATURE_5=n
CONFIG_FEATURE_6=n
CONFIG_FEATURE_7=n
CONFIG_FEATURE_8=n
CONFIG_FEATURE_9=n
CONFIG_FEATURE_10=n
CONFIG_FEATURE_11=y
CONFIG_FEATURE_12=n
CONFIG_FEATURE_13=n
CONFIG_FEATURE_14=n
CONFIG_FEATURE_15=n
CONFIG_FEATURE_16=n
CONFIG_FEATURE_17=n
CONFIG_FEATURE_18=n
CONFIG_FEATURE_19=n
CONFIG_FEATURE_20=n
CONFIG_FEATURE_21=n
CONFIG_FEATURE_22=y
CONFIG_FEATURE_23=n
CONFIG_FEATURE_24=n
CONFIG_FEATURE_25=n
CONFIG_FEATURE_26=n
CONFIG_FEATURE_27=n
CONFIG_FEATURE_28=n
CONFIG_FEATURE_29=n
CONFIG_FEATURE_30=n
CONFIG_FEATURE_31=n
CONFIG_FEATURE_32=n
CONFIG_FEATURE_33=y
CONFIG_FEATURE_34=n
CONFIG_FEATURE_35=n
CONFIG_FEATURE_36=n
CONFIG_FEATURE_37=n
CONFIG_FEATURE_38=n
CONFIG_FEATURE_39=n
CONFIG_FEATURE_40=n
CONFIG_FEATURE_41=n
CONFIG_FEATURE_42=n
CONFIG_FEATURE_43=n
CONFIG_FEATURE_44=y
CONFIG_FEATURE_45=n
CONFIG_FEATURE_46=n
CONFIG_FEATURE_47=n
CONFIG_FEATURE_48=n
CONFIG_FEATURE_49=n
CONFIG_FEATURE_50=n
CONFIG_FEATURE_51=n
CONFIG_FEATURE_52=n
CONFIG_FEATURE_53=n
CONFIG_FEATURE_54=n
CONFIG_FEATURE_55=y
CONFIG_FEATURE_56=n
CONFIG_FEATURE_57=n
CONFIG_FEATURE_58=n
CONFIG_FEATURE_59=n
CONFIG_FEATURE_60=n
CONFIG_FEATURE_61=n
CONFIG_FEATURE_62=n
CONFIG_FEATURE_63=n
CONFIG_FEATURE_64=n
CONFIG_FEATURE_65=n
CONFIG_FEATURE_66=y
CONFIG_FEATURE_67=n
CONFIG_FEATURE_68=n
CONFIG_FEATURE_69=n
CONFIG_FEATURE_70=n
CONFIG_FEATURE_71=n
CONFIG_FEATURE_72=n
CONFIG_FEATURE_73=n
CONFIG_FEATURE_74=n
CONFIG_FEATURE_75=n
CONFIG_FEATURE_76=n
CONFIG_FEATURE_77=y
CONFIG_FEATURE_78=n
CONFIG_FEATURE_79=n
CONFIG_FEATURE_80=n
CONFIG_FEATURE_81=n
CONFIG_FEATURE_82=n
CONFIG_FEATURE_83=n
CONFIG_FEATURE_84=n
CONFIG_FEATURE_85=n
CONFIG_FEATURE_86=n
CONFIG_FEATURE_87=n
CONFIG_FEATURE_88=y
CONFIG_FEATURE_89=n
CONFIG_FEATURE_90=n
CONFIG_FEATURE_91=n
CONFIG_FEATURE_92=n
CONFIG_FEATURE_93=n
CONFIG_FEATURE_94=n
CONFIG_FEATURE_95=n
CONFIG_FEATURE_96=n
CONFIG_FEATURE_97=n
CONFIG_FEATURE_98=n
CONFIG_FEATURE_99=y
CONFIG_FEATURE_100=n
// Customer customization
&i2c1 { temperature@48 { reg = <0x48>; }; };
&i2c1 { eeprom@50 { reg = <0x50>; }; };
&spi1 { status = "disabled"; };
&eth0 { phy-mode = "rmii"; };
&uart1 { current-speed = <9600>; };
&gpio1 { led0 { label = "status"; }; };
```
